/ {
    aliases{
        accel = &accel0;
    };
};


&spi1 {

    status = "okay";    

    accel0: adxl367@0 {
        compatible = "adi,adxl367";
        status = "okay";
        reg = <0>;
		spi-max-frequency = <100000>;
        fifo-mode = <3>;
    };

};